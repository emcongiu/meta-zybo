## conf/layer.conf
```bitbake
# We have a conf and classes directory, add to BBPATH
BBPATH := "${BBPATH}:${LAYERDIR}"

# We have a packages directory, add to BBFILES
BBFILES += "${LAYERDIR}/recipes-*/*/*.bb"
BBFILES += " ${LAYERDIR}/recipes-*/*/*.bbappend"

BBFILE_COLLECTIONS += "zybo"
BBFILE_PATTERN_zybo := "^${LAYERDIR}/"
BBFILE_PRIORITY_zybo = "6"

LAYERDEPENDS_zybo = "core"
```

## conf/machine/include/machine-digilent-default.inc
```bitbake
# Default Digilent BSP Machine settings

# File System Configuration
IMAGE_FSTYPES ?= "tar.gz cpio cpio.gz.u-boot"
IMAGE_CLASSES += "image_types_uboot"

# Kernel Configuration
PREFERRED_PROVIDER_virtual/kernel ?= "linux-xlnx"
PREFERRED_VERSION_linux-xlnx ?= "3.14%"
PREFERRED_VERSION_linux-yocto ?= "3.14%"

# U-Boot Configuration
PREFERRED_PROVIDER_virtual/bootloader ?= "u-boot-dglt"
PREFERRED_PROVIDER_u-boot ?= "u-boot-dglt"
PREFERRED_VERSION_u-boot-dglt ?= "v2014.01%"
UBOOT_SUFFIX ?= "img"

MACHINE_ESSENTIAL_EXTRA_RDEPENDS += "device-tree"

# Common Device Tree Includes
MACHINE_DEVICETREE_append_zynq += " \
		common/zynq7-base.dtsi \
		"
```

## conf/machine/zybo-zynq7.conf
```bitbake
#@TYPE: Machine
#@NAME: zybo-zynq7
#@DESCRIPTION: Machine support for Zybo. (http://www.digilentinc.com)
#
# For details on the Evaluation board:
#     http://www.digilentinc.com/Products/Detail.cfm?NavPath=2,400,1198&Prod=ZYBO
#

require conf/machine/include/tune-zynq.inc
require conf/machine/include/machine-digilent-default.inc
require conf/machine/include/machine-digilent-board.inc

# Zybo machine definition known by Digilent UBOOT
UBOOT_MACHINE = "zynq_zybo_config"

SERIAL_CONSOLE = "115200 ttyPS0"

MACHINE_DEVICETREE := " \
		zybo/zybo-zynq7-board.dtsi \
		zybo/zybo-zynq7.dts \
		"

IMAGE_BOOT_FILES += "boot.bin uEnv.txt ${MACHINE}.dtb"
```
